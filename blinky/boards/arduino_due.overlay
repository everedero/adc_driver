#include <dt-bindings/pinctrl/sam3XXe-pinctrl.h>
#include <zephyr/dt-bindings/gpio/gpio.h>
#include <freq.h>


&spi0 {
	status = "okay";
	pinctrl-0 = <&spi0_default>;
	pinctrl-names = "default";
	cs-gpios = <&pioa 28 GPIO_ACTIVE_LOW>;

        adcc: adcc@0 {
		compatible = "zephyr,custom_adc";
		spi-max-frequency = <DT_FREQ_M(1)>;
		status = "okay";
		reg = <0>;
		status = "disabled";
		#io-channel-cells = <1>;
		#address-cells = <1>;
		#size-cells = <0>;
	};
};

&twi0 {
        status = "disabled";
};

&tc0 {
	clk = <4>;
	status = "okay";
};
